## base_external/Config.in
```kconfig
source "$BR2_EXTERNAL_project_base_PATH/package/aesd-final/Config.in"
source "$BR2_EXTERNAL_project_base_PATH/package/cmake_test/Config.in"
#source "$BR2_EXTERNAL_project_base_PATH/package/aesd-assignments/Config.in"
```

## base_external/package/cmake_test/Config.in
```kconfig
config BR2_PACKAGE_CMAKE_TEST
	bool "CMAKE_TEST"
	help
	  test code to sample cmake with buildroot 
```
